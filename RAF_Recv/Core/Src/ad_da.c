/*
 * ad_da.c
 *
 *  Created on: Mar 28, 2022
 *      Author: 王志涵
 */

/**
 * @brief 检波后采集电压，并输出
 * @retval None
 */
#include "ad_da.h"
#include "main.h"
#include "base.h"
#include "tim.h"
#include "adc.h"
#include "dac.h"
#include "hmi_driver.h"
#include "hmi_user_uart.h"
#include "cmd_queue.h"
#include "cmd_process.h"

extern DMA_HandleTypeDef hdma_adc1;

uint16_t adData[ad_daLength];
uint16_t daData[ad_daLength];
uint8 uartData[ad_daLength];
float tempData[ad_daLength];
uint8_t getKey;
uint16_t Jag[2000]={
		0,3,6,9,12,15,18,21,24,27,30,33,36,39,42,
		45,48,51,54,57,60,63,66,69,72,75,78,81,84,87,
		90,93,96,99,102,105,108,111,114,117,120,123,126,129,132,
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				30,27,24,21,18,15,12,9,6,3
};

/**
 * @brief ADC_DAC使能函数
 * @retval None
 */
void ad_daStartGet(){

	uint16_t adMAX = 0;
	int Flag = 0;			//最大值标志位

	HAL_TIM_Base_Start(&htim2);
	HAL_TIM_Base_Start(&htim4);

	while(1){
		getKey = KEY_Scan(0);
		if(getKey==1){
			LED0 = !LED0;
			HAL_ADC_Start_DMA(&hadc1,(uint32_t *)adData,ad_daLength);
			HAL_Delay(1000);
			break;
		}
	}

	/*以下操作为将ADC采集的数据进行数组偏移*/
	for(int i = 0;i < 40;i++){
		if(adData[i] > adMAX){
			adMAX = adData[i];
			Flag = i;
		}
	}
	for(int j = 0;j < 40;j++){
		daData[j] = (uint16_t)adData[(j+Flag)%80];
	}
//	daData[0]=daData[2];
//	daData[1]=daData[2];
	for(int k = 0;k < 80;k++){
		tempData[k] = (float)daData[k];
	}
	for(int m = 0;m < 80;m++){
		uartData[m] = (uint8)(tempData[m]/adMAX*200);
	}
	HAL_DAC_Start_DMA(&hdac,DAC1_CHANNEL_2,(uint32_t *)Jag,1000,DAC_ALIGN_12B_R);
	HAL_Delay(784);
	HAL_DAC_Start_DMA(&hdac,DAC1_CHANNEL_1,(uint32_t *)daData,ad_daLength/2,DAC_ALIGN_12B_R);
}

/**
 * @brief DMA流处理函数
 * @retval None
 */
//void DMA2_Stream0_Handler(){
//
//	/*判断是否接收完成*/
//	if(__HAL_DMA_GET_FLAG(&hdma_adc1,DMA_FLAG_TCIF1_5) != RESET){
//		__HAL_DMA_CLEAR_FLAG(&hdma_adc1,DMA_FLAG_TCIF1_5);		//清除DMA接收完成标志
//
//		for(int i = 40;i < 80;i++){
//			daData[i] = (uint16_t)adData[i];
//		}
//	}
//
//	/*判断是否接收半完成*/
//	if(__HAL_DMA_GET_FLAG(&hdma_adc1,DMA_FLAG_HTIF1_5) != RESET){
//		__HAL_DMA_CLEAR_FLAG(&hdma_adc1,DMA_FLAG_HTIF1_5);
//
//		for(int i = 0;i < 40;i++)
//		{
//			daData[i] = (uint16_t)adData[i];
//		}
//	}
//}
